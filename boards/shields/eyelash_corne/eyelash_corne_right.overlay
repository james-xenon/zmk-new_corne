/*
 *
 * Copyright (c) 2024 The ZMK Contributors
 * SPDX-License-Identifier: MIT
 *
 */

#include "eyelash_corne.dtsi"

/* No physical encoder on the right/peripheral half. */
&qdec0 {
    status = "disabled";
};

&default_transform {
    col-offset = <7>;
};
